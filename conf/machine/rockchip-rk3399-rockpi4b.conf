## conf/machine/rockchip-rk3399-rockpi4b.conf
```bitbake
#@TYPE: Machine
#@NAME: RAXAR Rock Pi 4B 

SOC_FAMILY ?= "rk3399"

require conf/machine/include/tune-cortexa72.inc
require conf/machine/include/soc-family.inc

KERNEL_IMAGETYPE ?= "Image"
KBUILD_DEFCONFIG ?= "rk3399_rockpi4b_defconfig"
KERNEL_DEVICETREE ?= "rockchip/rk3399-rock-pi-4.dtb"
MACHINEOVERRIDES =. "rockchip:"
#KERNEL_IMAGETYPE_FOR_MAKE ?= "boot.img"
IMAGE_BOOT_FILES ?= "${KERNEL_IMAGETYPE} rk3399-rock-pi-4.dtb extlinux.conf"


PREFERRED_PROVIDER_virtual/kernel ?= "linux-mainline"


MACHINE_EXTRA_RRECOMMENDS_append = " \
	kernel-modules \
"

PREFERRED_PROVIDER_virtual/bootloader ?= "uboot-rockpi4b"
UBOOT_MACHINE = "rock-pi-4b-rk3399_defconfig"


RK_MINILOADER_INI ?= "${@d.getVar('SOC_FAMILY').upper() + 'MINIALL.ini'}"
RK_TRUST_INI = "${@d.getVar('SOC_FAMILY').upper() + 'TRUST.ini'}"
RK_LOADER_SIZE ?= "1024"
RK_LOADER_BACKUP_NUM ?= "1"

IMAGE_FSTYPES_remove += "iso live"
RK_ROOTFS_TYPE ?= "ext4"
RK_ROOTDEV_UUID = "B921B045-1DF0-41C3-AF44-4C6F280D3FAE"

IMAGE_FSTYPES += "${RK_ROOTFS_TYPE}"
#WKS_FILE ?= "rockpi4b-gptdisk.wks.in"
do_image_wic[depends] += " \
	virtual/kernel:do_deploy \
	virtual/bootloader:do_deploy \
	rk-binary-loader:do_deploy \
	uboot-rockpi4b:do_compile \
"

#IMAGE_CLASSES += "gpt-image"
```
